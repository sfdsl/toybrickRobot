/****************************************************************************
*Copyright：--武汉莱斯特电子科技有限公司--
*File name：	Color.c
*Author：xx
*ID：YLX-01
*Version：1.0.0
*Date：
*Description：颜色传感器驱动库，需要用到TIM1和TIM2，移植时需要注意IO口
*History：
****************************************************************************/

/*引入头文件*/
#include "color.h"
#include <STC8.H>

/*定义引脚接口*/
sbit S2 = P1^7;
sbit S3 = P1^6;
sbit OUT = P3^5;/*特殊引脚--修改时需要注意*/

/*全局变量*/
unsigned short R_data,G_data,B_data;
unsigned short k_R = 173, k_G = 196, k_B = 96;   // 白平衡校准系数
/****************************************************************************
* 名    称：Color_Init
* 功    能：颜色传感器初始化
* 入口参数：无
* 出口参数：无
* 说    明：初始化定时器和计数器，初始化TIM1和TIM2
* 调用方法：无
****************************************************************************/
void Color_Init()
{
	/*定时器时钟12T模式*/
	AUXR &= 0x7F;
	
	/*T1计数 T0定时*/
	TMOD = 0x50;
	
	/*定时器0初值  20ms@24MHz */
	TL0 = 0xC0;
	TH0 = 0x63;
	
	/*计数器清空*/
	TH1=0x00;
	TL1=0x00;
	
	/*开中断*/
	EA=1;
	ET0=1;
	
	/*清除TF0标志*/
	TF0 = 0;
	
	/*启动定时器和计数器*/
	TR0=1;
	TR1=1;
}

/****************************************************************************
* 函数名称: c20ms_out() 
* 函数功能: 定时中断0服务程序
*          	修改颜色标志step（0:红 1:绿 2:蓝）设置S0 S1 S2 选择滤波器计算脉冲，读取色值
* 入口参数: 无
* 出口参数: 无
****************************************************************************/
void c20ms_out() interrupt 1
{
	static unsigned char step = 0; //分三步步骤
	
	TR0=0;  //关闭定时
	TR1=0;  //关闭计数
	
	/*step+1实现先检测绿色,再检测蓝色,然后检测红色,循环检测*/
	if(step == 0){
		step ++;    
		S2=1;S3=1;          	//选择滤波器为绿色
		R_data=(TH1<<8)+TL1;  //计算这段时间内 TCS230 的输出脉冲数
        R_data = (unsigned long)R_data * 256 / k_R;
	}
	else if(step == 1){
		step ++;
		S2=0;S3=1;          	//选择滤波器为蓝色
		G_data=(TH1<<8)+TL1;	//计算这段时间内 TCS230 的输出脉冲数
        G_data = (unsigned long)G_data * 256 / k_G;
	}
	else{
		step = 0;
		S2=0;S3=0;         	  //选择滤波器为红色
		B_data=(TH1<<8)+TL1;  //计算这段时间内 TCS230 的输出脉冲数
        B_data = (unsigned long)B_data * 256 / k_B;
	}
	
	/*计数器清零*/
	TL1=0x00;
	TH1=0x00;
    
    // 定时器恢复初始值
    TL0 = 0xC0;
	TH0 = 0x63;
	
	/*打开定时器和计数器*/
	TR0=1;
	TR1=1;
}

/****************************************************************************
* 函数名称: 
* 函数功能: 白平衡校准
*          	
* 入口参数: 无
* 出口参数: 无
****************************************************************************/
void whiteBalance(void)
{
    if ((k_R == 1) && (k_G == 1) && (k_B == 1))
    {   // 如果已经校准过，则不再校准
        k_R = R_data;
        k_G = G_data;
        k_B = B_data;
        
        while ((k_R & 0x01 == 0) && (k_G & 0x01 == 0) && (k_B & 0x01 == 0))
        {   // 去掉公约数2
            k_R >>= 1;
            k_G >>= 1;
            k_B >>= 1;
        }
    }
}

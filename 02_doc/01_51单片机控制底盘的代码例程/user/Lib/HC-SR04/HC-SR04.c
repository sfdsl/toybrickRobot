/****************************************************************************
*Copyright：--武汉莱斯特电子科技有限公司--
*File name：	main.c
*Author：xx
*ID：YLX-01
*Version：1.0.0
*Date：
*Description：超声波测距函数（非堵线程方式），此函数用到了外部中断1和PAC，移植时需要注意
*History：		测试晶振频率24M
****************************************************************************/

/*引入头文件*/
#include "hc-sr04.h"
#include <STC8.H>

/*定义IO口*/

sbit Echo = P3^3; //此引脚为特殊引脚，修改要注意
sbit Trig = P3^4; //触发引脚，可以任意IO口

/*全局变量*/
static unsigned char Tim_H,Tim_L;
static unsigned char Flag = 0;

/****************************************************************************
* 名    称：Delay12us
* 功    能：精确延时
* 入口参数：无
* 出口参数：无
* 说    明：无
* 调用方法：无
****************************************************************************/
static void Delay12us()		//@24.000MHz
{
	unsigned char i;

	i = 94;
	while (--i);
}

/****************************************************************************
* 名    称：HC_SR04_Init
* 功    能：超声波测距初始化
* 入口参数：无
* 出口参数：无
* 说    明：初始外部中断1和定时器4
* 调用方法：while循环前调用
****************************************************************************/
void HC_SR04_Init()
{
	IT1 = 0;      //使能INT1上升沿和下降沿中断
	EX1 = 1;      //使能INT1中断
	Trig = 0;
	
	CCON = 0x00;
	CMOD = 0x00;			 //PCA时钟为系统时钟/12
	CL = 0x00;
	CH = 0x00;
	CCAPM0 = 0x48;     //PCA模块0为16位定时器模式
	CCAP0L = 0x00;
	CCAP0H = 0x00;
	CR = 0;            //停止PCA计时器
	
	//EA = 1;
}

/****************************************************************************
* 名    称：HC_SR04_Trig
* 功    能：开始一次测距
* 入口参数：无
* 出口参数：无
* 说    明：无
* 调用方法：无需调用
****************************************************************************/
static void HC_SR04_Trig()
{
	Trig = 1;
	Delay12us();
	Trig = 0;
}

/****************************************************************************
* 名    称：HC_SR04_Read
* 功    能：读取测试到的距离
* 入口参数：无
* 出口参数：测量的距离，正在测量中返回-1
* 说    明：单位mm
* 调用方法：无
****************************************************************************/
int HC_SR04_Read()
{
	if(Flag >1)
	{
		Flag = 0;
		return ((Tim_H<<8)|Tim_L)/2.0*187/1000;
	}
	else
	{
		HC_SR04_Trig();
	}
	return -1;
}

/****************************************************************************
* 名    称：INT1_Isr
* 功    能：外部中断1
* 入口参数：无
* 出口参数：无
* 说    明：无
* 调用方法：无需用户调用
****************************************************************************/
void INT1_Isr() interrupt 2
{
    if (Echo) //判断上升沿和下降沿
    {
        /*上升沿*/
        CR = 1;            //启动PCA计时器
    }
    else
    {
        /*下降沿*/
        CR = 0;            //停止PCA计时器
        Tim_L = CL;
        Tim_H = CH;
        Flag ++;
        CL = 0;
        CH = 0;
    }
}

